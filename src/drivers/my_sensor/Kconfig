## src/drivers/my_sensor/Kconfig
```kconfig
menuconfig DRIVERS_MY_SENSOR
	bool "my_sensor"
	default n
	---help---
		Enable support for my_sensor example
```

## src/examples/sky_app/Kconfig
```kconfig
menuconfig EXAMPLES_SKY_APP
	bool "test_app"
	default n
	---help---
		Enable support for test_app example
```

## src/examples/sky_app_nuttx_驱动接口/Kconfig
```kconfig
menuconfig EXAMPLES_SKY_APP
	bool "sky_cdev"
	default n
	---help---
		Enable support for sky_cdev example
```

## src/examples/sky_app_工作队列/Kconfig
```kconfig
menuconfig EXAMPLES_SKY_APP
	bool "sky_app"
	default n
	---help---
		Enable support for sky_app example
```

## src/examples/test_app/Kconfig
```kconfig
menuconfig EXAMPLES_TEST_APP
	bool "test_app"
	default n
	---help---
		Enable support for test_app
```

## src/examples/test_cdev/Kconfig
```kconfig
menuconfig EXAMPLES_TEST_CDEV

    bool "test_cdev"
    default n
    -----help----
        Enable support for test_cdev
```
